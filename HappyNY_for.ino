const int pin = 6;    // номер порта зуммера
const byte notes = 14; // Колличество нот во фразе
const int del = 300;   // Длительность нот
byte PWM_led_R, PWM_led_G, PWM_led_B;
byte pin_led_R = 3; // Номер контакта для Светодиода R
byte pin_led_G = 5; // Номер контакта для Светодиода G
byte pin_led_B = 6; // Номер контакта для Светодиода B
int freq1[notes] = {523, 880, 880, 784, 880, 698, 523, 523, 523, 880, 880, 932, 784, 1046}; //частоты нот первой фразы
int freq2[notes] = {1046, 587, 587, 932, 932, 880, 784, 698, 523, 880, 880, 784, 880, 698}; //частоты нот второй фразы

void setup() {
  pinMode(pin_led_R, OUTPUT);  // Настраиваем контакт на выход
  pinMode(pin_led_G, OUTPUT);  // Настраиваем контакт на выход
  pinMode(pin_led_B, OUTPUT);  // Настраиваем контакт на выход
  pinMode(pin, OUTPUT);  // Настраиваем порт на выход  
  Serial.begin(9600);    // Открываем порт
}

void loop() {

// Первая фраза  

  for (int i = 0; i < notes; i++ ) // Цикл от 0 до количества нот
  {
    Serial.print(i); Serial.print("-"); Serial.println(freq1[i]); // Пишем в порт
    PWM_led_R = random(0, 254); // Генерируем случайное число от 0 до 254
    PWM_led_G = random(0, 254); // Генерируем случайное число от 0 до 254
    PWM_led_B = random(0, 254); // Генерируем случайное число от 0 до 254
    analogWrite(pin_led_R, PWM_led_R); // Зажигаем светодлиод на случайно сгенерированную яркость
    analogWrite(pin_led_G, PWM_led_G); // Зажигаем светодлиод на случайно сгенерированную яркость
    analogWrite(pin_led_B, PWM_led_B); // Зажигаем светодлиод на случайно сгенерированную яркость

    if (i!=13) 
      {
      tone(pin, freq1[i], del);   // Включаем звук, определенной частоты
      delay(del);                 // Пауза для заданой ноты
      noTone(pin);                // Останавливаем звук
      }
    else 
      {
      tone(pin, freq1[i], del*4); // Включаем звук, определенной частоты и длительности
      delay(del*2);               // Пауза для заданой ноты
      noTone(pin);                // Останавливаем звук  
      }
  }
  delay(del);                     // Пауза после фразы
  
// Вторая фраза  

  for (int i = 0; i < notes; i++ ) // Цикл от 0 до количества нот
  {
    Serial.print(i); Serial.print("-"); Serial.println(freq1[i]); // Пишем в порт
    PWM_led_R = random(0, 254); // Генерируем случайное число от 0 до 254
    PWM_led_G = random(0, 254); // Генерируем случайное число от 0 до 254
    PWM_led_B = random(0, 254); // Генерируем случайное число от 0 до 254
    analogWrite(pin_led_R, PWM_led_R); // Зажигаем светодлиод на случайно сгенерированную яркость
    analogWrite(pin_led_G, PWM_led_G); // Зажигаем светодлиод на случайно сгенерированную яркость
    analogWrite(pin_led_B, PWM_led_B); // Зажигаем светодлиод на случайно сгенерированную яркость
         
    if (i!=13) 
      {
      tone(pin, freq2[i], del);   // Включаем звук, определенной частоты
      delay(del);                 // Пауза для заданой ноты
      noTone(pin);                // Останавливаем звук
      }
    else 
      {
      tone(pin, freq2[i], del*4); // Включаем звук, определенной частоты и длительности
      delay(del*2);               // Пауза для заданой ноты
      noTone(pin);                // Останавливаем звук  
      }
  }
  delay(del);                     // Пауза после фразы
}
